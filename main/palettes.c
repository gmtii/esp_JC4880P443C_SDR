#include "palettes.h"

#include <string.h>

/*
 * Palette data ported verbatim from the DeepSDR 101 firmware's spectrum.c,
 * where it was converted from SDR++'s colormap JSON files
 * (https://github.com/AlexandreRouma/SDRPlusPlus, root/res/colormaps/,
 * GPL-3.0). Authors of the individual maps, as credited in those files:
 *   Classic - Youssef Touil        GQRX - csete
 *   Turbo - Google AI              Viridis/Inferno/Magma/Plasma - B.I.D.S.
 *   Electric, WebSDR - Ryzerth     Classic Green - Paul (PD0SWL)
 *   Smoke, Temper Colors, Vivid - Yaroslav Andrianov
 *   Grayscale - matches SDR++'s "Grey Scale"
 *   Fire - DeepSDR 101's own addition (not from SDR++)
 * The six maps that ship as exactly 256 stops are stored as ready RGB565
 * LUTs; the rest are stop tables linearly interpolated into 256 entries.
 */

static inline uint16_t rgb565(uint8_t r, uint8_t g, uint8_t b)
{
    return (uint16_t)(((uint16_t)(r & 0xF8) << 8) | ((uint16_t)(g & 0xFC) << 3) | (uint16_t)(b >> 3));
}

static const uint16_t k_lut_gqrx[256] = {
    0x0000U, 0x0000U, 0x0000U, 0x0000U, 0x0000U, 0x0000U, 0x0000U, 0x0000U, 0x0000U, 0x0000U, 0x0000U, 0x0000U,
    0x0000U, 0x0000U, 0x0000U, 0x0000U, 0x0000U, 0x0000U, 0x0000U, 0x0000U, 0x0000U, 0x0000U, 0x0000U, 0x0001U,
    0x0001U, 0x0001U, 0x0002U, 0x0002U, 0x0002U, 0x0003U, 0x0003U, 0x0003U, 0x0004U, 0x0004U, 0x0004U, 0x0005U,
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    0xFB2CU, 0xFCD3U, 0xFE79U, 0xFFFFU,
};

static const uint16_t k_lut_inferno[256] = {
    0x0000U, 0x0000U, 0x0000U, 0x0001U, 0x0001U, 0x0001U, 0x0001U, 0x0002U, 0x0002U, 0x0002U, 0x0022U, 0x0023U,
    0x0023U, 0x0823U, 0x0823U, 0x0824U, 0x0824U, 0x0844U, 0x0845U, 0x0845U, 0x1045U, 0x1046U, 0x1046U, 0x1046U,
    0x1046U, 0x1047U, 0x1867U, 0x1867U, 0x1868U, 0x1868U, 0x1868U, 0x1869U, 0x2069U, 0x2069U, 0x2069U, 0x206AU,
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    0xFFD3U, 0xFFF3U, 0xFFF4U, 0xFFF4U,
};

static const uint16_t k_lut_magma[256] = {
    0x0000U, 0x0000U, 0x0000U, 0x0001U, 0x0001U, 0x0001U, 0x0001U, 0x0001U, 0x0002U, 0x0022U, 0x0022U, 0x0023U,
    0x0023U, 0x0023U, 0x0823U, 0x0824U, 0x0844U, 0x0844U, 0x0844U, 0x0845U, 0x0845U, 0x1045U, 0x1065U, 0x1066U,
    0x1066U, 0x1066U, 0x1067U, 0x1067U, 0x1867U, 0x1887U, 0x1888U, 0x1888U, 0x1888U, 0x1889U, 0x2089U, 0x2089U,
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    0xFFB7U, 0xFFD7U, 0xFFD7U, 0xFFF7U,
};

static const uint16_t k_lut_plasma[256] = {
    0x0850U, 0x1031U, 0x1031U, 0x1031U, 0x1831U, 0x1831U, 0x1831U, 0x2031U, 0x2032U, 0x2032U, 0x2032U, 0x2832U,
    0x2832U, 0x2832U, 0x2832U, 0x2832U, 0x3032U, 0x3032U, 0x3033U, 0x3033U, 0x3833U, 0x3833U, 0x3833U, 0x3833U,
    0x3833U, 0x4033U, 0x4013U, 0x4013U, 0x4013U, 0x4813U, 0x4814U, 0x4814U, 0x4814U, 0x4814U, 0x5014U, 0x5014U,
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    0xF7A4U, 0xF7A4U, 0xF7A4U, 0xF7C4U,
};

static const uint16_t k_lut_turbo[256] = {
    0x3087U, 0x30A8U, 0x30C9U, 0x30CAU, 0x30EBU, 0x310BU, 0x312CU, 0x392DU, 0x394EU, 0x396FU, 0x3970U, 0x3990U,
    0x39B1U, 0x39D2U, 0x39D2U, 0x39F3U, 0x4214U, 0x4214U, 0x4235U, 0x4256U, 0x4256U, 0x4277U, 0x4297U, 0x42B8U,
    0x42B8U, 0x42D9U, 0x42F9U, 0x42FAU, 0x431AU, 0x433BU, 0x433BU, 0x435CU, 0x435CU, 0x437CU, 0x439DU, 0x439DU,
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    0x8020U, 0x8020U, 0x7820U, 0x7820U,
};

static const uint16_t k_lut_viridis[256] = {
    0x400AU, 0x400AU, 0x402AU, 0x402BU, 0x402BU, 0x404BU, 0x404BU, 0x404BU, 0x406CU, 0x406CU, 0x408CU, 0x408CU,
    0x408CU, 0x48ACU, 0x48ADU, 0x48ADU, 0x48CDU, 0x48CDU, 0x48CDU, 0x48EDU, 0x48EDU, 0x48EEU, 0x490EU, 0x490EU,
    0x490EU, 0x492EU, 0x492EU, 0x492EU, 0x494FU, 0x494FU, 0x414FU, 0x416FU, 0x416FU, 0x416FU, 0x416FU, 0x418FU,
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    0xF724U, 0xFF24U, 0xFF24U, 0xFF24U,
};

static const uint8_t k_stops_classic[15][3] = {
    {0U, 0U, 32U},
    {0U, 0U, 48U},
    {0U, 0U, 80U},
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    {74U, 0U, 0U},
};

static const uint8_t k_stops_classic_green[13][3] = {
    {0U, 0U, 0U},
    {0U, 0U, 48U},
    {0U, 40U, 81U},
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    {74U, 0U, 0U},
};

static const uint8_t k_stops_electric[4][3] = {
    {0U, 0U, 0U},
    {0U, 0U, 255U},
    {0U, 255U, 255U},
    {255U, 255U, 255U},
};

static const uint8_t k_stops_smoke[8][3] = {
    {255U, 255U, 255U},
    {238U, 238U, 238U},
    {204U, 204U, 204U},
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    {0U, 0U, 0U},
};

static const uint8_t k_stops_temper_colors[22][3] = {
    {0U, 0U, 0U},
    {5U, 1U, 31U},
    {15U, 8U, 54U},
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    {116U, 30U, 79U},
};

static const uint8_t k_stops_vivid[23][3] = {
    {0U, 0U, 0U},
    {6U, 0U, 28U},
    {9U, 0U, 40U},
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    {152U, 14U, 1U},
};

static const uint8_t k_stops_websdr[5][3] = {
    {0U, 0U, 0U},
    {0U, 0U, 80U},
    {255U, 0U, 255U},
    {255U, 255U, 80U},
    {255U, 255U, 255U},
};

static uint16_t lerp_stops(const uint8_t stops[][3], int n_stops, float t)
{
    float pos, u;
    int i0, i1;

    if (t < 0.0f) t = 0.0f;
    if (t > 1.0f) t = 1.0f;
    pos = t * (float)(n_stops - 1);
    i0 = (int)pos;
    if (i0 > n_stops - 2) i0 = n_stops - 2; /* t = 1.0 exact edge */
    i1 = i0 + 1;
    u = pos - (float)i0;
    return rgb565((uint8_t)((float)stops[i0][0] + u * ((float)stops[i1][0] - (float)stops[i0][0])),
                  (uint8_t)((float)stops[i0][1] + u * ((float)stops[i1][1] - (float)stops[i0][1])),
                  (uint8_t)((float)stops[i0][2] + u * ((float)stops[i1][2] - (float)stops[i0][2])));
}

/* Fire: black -> red -> orange -> yellow -> white, independent per-channel ramps. */
static uint16_t eval_fire(float t)
{
    if (t < 1.0f / 3.0f)
    {
        return rgb565((uint8_t)(t * 3.0f * 255.0f), 0, 0);
    }
    if (t < 2.0f / 3.0f)
    {
        return rgb565(255, (uint8_t)((t - 1.0f / 3.0f) * 3.0f * 255.0f), 0);
    }
    if (t > 1.0f)
    {
        t = 1.0f;
    }
    return rgb565(255, 255, (uint8_t)((t - 2.0f / 3.0f) * 3.0f * 255.0f));
}

static const char *const k_names[PALETTE_COUNT] = {
    "Classic",
    "Fire",
    "Viridis",
    "Grayscale",
    "Turbo",
    "Inferno",
    "Magma",
    "Plasma",
    "GQRX",
    "Electric",
    "Classic Green",
    "Smoke",
    "Temper Colors",
    "Vivid",
    "WebSDR",
};

const char *palette_name(int id)
{
    return (id >= 0 && id < PALETTE_COUNT) ? k_names[id] : k_names[PALETTE_CLASSIC];
}

void palette_build_lut(int id, uint16_t lut[256])
{
    const uint16_t *ready = NULL;
    const uint8_t(*stops)[3] = k_stops_classic;
    int n_stops = 15;

    switch (id)
    {
    case PALETTE_GQRX:    ready = k_lut_gqrx; break;
    case PALETTE_INFERNO: ready = k_lut_inferno; break;
    case PALETTE_MAGMA:   ready = k_lut_magma; break;
    case PALETTE_PLASMA:  ready = k_lut_plasma; break;
    case PALETTE_TURBO:   ready = k_lut_turbo; break;
    case PALETTE_VIRIDIS: ready = k_lut_viridis; break;
    default: break;
    }
    if (ready != NULL)
    {
        memcpy(lut, ready, 256 * sizeof(uint16_t));
        return;
    }

    if (id == PALETTE_FIRE || id == PALETTE_GRAYSCALE)
    {
        for (int i = 0; i < 256; i++)
        {
            lut[i] = (id == PALETTE_FIRE) ? eval_fire((float)i * (1.0f / 255.0f))
                                          : rgb565((uint8_t)i, (uint8_t)i, (uint8_t)i);
        }
        return;
    }

    switch (id)
    {
    case PALETTE_ELECTRIC:      stops = k_stops_electric;      n_stops = 4;  break;
    case PALETTE_CLASSIC_GREEN: stops = k_stops_classic_green; n_stops = 13; break;
    case PALETTE_SMOKE:         stops = k_stops_smoke;         n_stops = 8;  break;
    case PALETTE_TEMPER_COLORS: stops = k_stops_temper_colors; n_stops = 22; break;
    case PALETTE_VIVID:         stops = k_stops_vivid;         n_stops = 23; break;
    case PALETTE_WEBSDR:        stops = k_stops_websdr;        n_stops = 5;  break;
    default:                    break; /* Classic */
    }
    for (int i = 0; i < 256; i++)
    {
        lut[i] = lerp_stops(stops, n_stops, (float)i * (1.0f / 255.0f));
    }
}

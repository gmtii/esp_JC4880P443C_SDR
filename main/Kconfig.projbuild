## main/Kconfig.projbuild
```kconfig
menu "SDR: DMR"

    config DMR_VOICE_MBELIB
        bool "DMR voice (mbelib, AMBE+2)"
        default n
        help
            Decode DMR voice with mbelib. mbelib is not included in this
            repository (the AMBE+2 algorithm is covered by patents in some
            countries): run tools/fetch_mbelib.sh first. When disabled, DMR
            mode decodes metadata only (IDs, talkgroup, talker alias).

    config DMR_VOICE_UVQUALITY
        int "mbelib unvoiced synthesis quality (1-3)"
        depends on DMR_VOICE_MBELIB
        range 1 3
        default 3
        help
            Quality of the noise-like (unvoiced) parts of speech. 3 is the
            DSD default; 1 roughly halves the vocoder's CPU use. The DMR panel
            shows the measured vocoder time per 20 ms frame ("voc").

endmenu
```
